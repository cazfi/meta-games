## conf/layer.conf
```bitbake
# We have a conf and classes directory, append to BBPATH
BBPATH .= ":${LAYERDIR}"

# We have a recipes directory, add to BBFILES
BBFILES += "${LAYERDIR}/recipes*/*/*.bb ${LAYERDIR}/dependencies/*/*.bb ${LAYERDIR}/test/images/*/*.bb"

BBFILE_COLLECTIONS += "games-layer"
BBFILE_PATTERN_games-layer := "^${LAYERDIR}/"
BBFILE_PRIORITY_games-layer = "15"

LAYERSERIES_COMPAT_games-layer = "rocko sumo thud"
```
